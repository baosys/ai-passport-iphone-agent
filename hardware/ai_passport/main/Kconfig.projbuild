## hardware/ai_passport/main/Kconfig.projbuild
```kconfig
menu "AI Passport iPhone Agent"

    config AGENT_BLE_NAME
        string "Bluetooth name"
        default "AI Passport"
        help
            Name the iPhone shows in Settings > Bluetooth.

    config AGENT_MOVE_STEP
        int "Pointer units per HID report"
        range 1 127
        default 10
        help
            A move is split along its line into reports of at most this many units
            (vector length, so every direction runs at the same speed), sent at a
            constant pace so iOS pointer acceleration stays predictable. The
            agent server calibrates against whatever pace is used; recalibrate
            after changing it.

    config AGENT_REPORT_INTERVAL_MS
        int "HID report interval (ms)"
        range 5 50
        default 15
        help
            Pause after each HID report. BLE delivers reports once per
            connection event (iOS uses 11.25-30 ms for HID devices), so a pace
            close to the connection interval keeps the motion even.

    config AGENT_HOME_REPORTS
        int "Reports used to push the pointer into the top-left corner"
        default 50

    config AGENT_WIFI_SSID
        string "Default Wi-Fi SSID (optional)"
        default ""
        help
            Leave empty to use only the USB link. Usually set at runtime with
            tools/usb_link.py --wifi; values saved that way override this.

    config AGENT_WIFI_PASSWORD
        string "Default Wi-Fi password"
        default ""

    config AGENT_SERVER_HOST
        string "Default agent server host"
        default ""
        help
            IP address or host name of the machine running `python -m hidagent`.

    config AGENT_SERVER_PORT
        int "Default agent server board port"
        range 1 65535
        default 7300

endmenu
```
